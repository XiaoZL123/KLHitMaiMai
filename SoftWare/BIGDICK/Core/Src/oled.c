#include "oled.h"

#include <string.h>

#define OLED_PAGE_COUNT (OLED_HEIGHT / 8U)

static I2C_HandleTypeDef *oled_i2c;
static uint8_t oled_buffer[OLED_WIDTH * OLED_PAGE_COUNT];
static uint8_t oled_cursor_x;
static uint8_t oled_cursor_y;

/* 5x7 ASCII 字库，字符范围为 0x20 至 0x7E。 */
static const uint8_t oled_font_5x7[95][5] = {
  {0x00,0x00,0x00,0x00,0x00},{0x00,0x00,0x5F,0x00,0x00},
  {0x00,0x07,0x00,0x07,0x00},{0x14,0x7F,0x14,0x7F,0x14},
  {0x24,0x2A,0x7F,0x2A,0x12},{0x23,0x13,0x08,0x64,0x62},
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  {0x08,0x04,0x08,0x10,0x08}
};

/* 发送一组 SSD1306 命令。 */
static HAL_StatusTypeDef OLED_WriteCommands(const uint8_t *commands, uint16_t length)
{
  uint8_t packet[32];

  while (length > 0U)
  {
    uint16_t chunk = (length > 31U) ? 31U : length;
    packet[0] = 0x00U;
    memcpy(&packet[1], commands, chunk);
    if (HAL_I2C_Master_Transmit(oled_i2c, OLED_I2C_ADDRESS, packet,
                                chunk + 1U, OLED_TIMEOUT_MS) != HAL_OK)
    {
      return HAL_ERROR;
    }
    commands += chunk;
    length -= chunk;
  }
  return HAL_OK;
}

/* 发送一段 SSD1306 显存数据。 */
static HAL_StatusTypeDef OLED_WriteData(const uint8_t *data, uint16_t length)
{
  uint8_t packet[129];

  while (length > 0U)
  {
    uint16_t chunk = (length > 128U) ? 128U : length;
    packet[0] = 0x40U;
    memcpy(&packet[1], data, chunk);
    if (HAL_I2C_Master_Transmit(oled_i2c, OLED_I2C_ADDRESS, packet,
                                chunk + 1U, OLED_TIMEOUT_MS) != HAL_OK)
    {
      return HAL_ERROR;
    }
    data += chunk;
    length -= chunk;
  }
  return HAL_OK;
}

/* 初始化 SSD1306 屏幕并清空显示。 */
HAL_StatusTypeDef OLED_Init(I2C_HandleTypeDef *hi2c)
{
  static const uint8_t init_commands[] = {
    0xAE, 0xD5, 0x80, 0xA8, OLED_HEIGHT - 1U, 0xD3, 0x00, 0x40,
    0x8D, 0x14, 0x20, 0x00, 0xA1, 0xC8, 0xDA, 0x12,
    0x81, 0x7F, 0xD9, 0xF1, 0xDB, 0x40, 0xA4, 0xA6, 0xAF
  };

  if (hi2c == NULL)
  {
    return HAL_ERROR;
  }

  oled_i2c = hi2c;
  HAL_Delay(100U);
  if (HAL_I2C_IsDeviceReady(oled_i2c, OLED_I2C_ADDRESS, 3U,
                            OLED_TIMEOUT_MS) != HAL_OK)
  {
    return HAL_ERROR;
  }
  if (OLED_WriteCommands(init_commands, sizeof(init_commands)) != HAL_OK)
  {
    return HAL_ERROR;
  }

  OLED_Fill(OLED_COLOR_BLACK);
  return OLED_UpdateScreen();
}

/* 将显存完整刷新到屏幕。 */
HAL_StatusTypeDef OLED_UpdateScreen(void)
{
  static const uint8_t address_commands[] = {
    0x21, 0x00, OLED_WIDTH - 1U,
    0x22, 0x00, OLED_PAGE_COUNT - 1U
  };

  if (oled_i2c == NULL)
  {
    return HAL_ERROR;
  }
  if (OLED_WriteCommands(address_commands, sizeof(address_commands)) != HAL_OK)
  {
    return HAL_ERROR;
  }
  return OLED_WriteData(oled_buffer, sizeof(oled_buffer));
}

/* 设置屏幕对比度。 */
HAL_StatusTypeDef OLED_SetContrast(uint8_t contrast)
{
  uint8_t commands[] = {0x81, contrast};
  return (oled_i2c == NULL) ? HAL_ERROR :
         OLED_WriteCommands(commands, sizeof(commands));
}

/* 打开 OLED 显示。 */
HAL_StatusTypeDef OLED_DisplayOn(void)
{
  const uint8_t command = 0xAF;
  return (oled_i2c == NULL) ? HAL_ERROR : OLED_WriteCommands(&command, 1U);
}

/* 关闭 OLED 显示。 */
HAL_StatusTypeDef OLED_DisplayOff(void)
{
  const uint8_t command = 0xAE;
  return (oled_i2c == NULL) ? HAL_ERROR : OLED_WriteCommands(&command, 1U);
}

/* 使用指定颜色填充整个显存。 */
void OLED_Fill(OLED_Color color)
{
  memset(oled_buffer, (color == OLED_COLOR_WHITE) ? 0xFF : 0x00,
         sizeof(oled_buffer));
}

/* 在显存中绘制一个像素。 */
void OLED_DrawPixel(uint8_t x, uint8_t y, OLED_Color color)
{
  uint16_t index;
  uint8_t mask;

  if ((x >= OLED_WIDTH) || (y >= OLED_HEIGHT))
  {
    return;
  }

  index = x + ((uint16_t)(y / 8U) * OLED_WIDTH);
  mask = (uint8_t)(1U << (y % 8U));
  if (color == OLED_COLOR_WHITE)
  {
    oled_buffer[index] |= mask;
  }
  else
  {
    oled_buffer[index] &= (uint8_t)~mask;
  }
}

/* 设置下一个字符的左上角坐标。 */
void OLED_SetCursor(uint8_t x, uint8_t y)
{
  oled_cursor_x = x;
  oled_cursor_y = y;
}

/* 将一个 5x7 ASCII 字符写入显存。 */
char OLED_WriteChar(char ch, OLED_Color color)
{
  uint8_t column;
  uint8_t row;

  if ((ch < 0x20) || (ch > 0x7E) ||
      (oled_cursor_x + 6U > OLED_WIDTH) ||
      (oled_cursor_y + 8U > OLED_HEIGHT))
  {
    return 0;
  }

  for (column = 0U; column < 5U; column++)
  {
    uint8_t bits = oled_font_5x7[(uint8_t)ch - 0x20U][column];
    for (row = 0U; row < 8U; row++)
    {
      OLED_DrawPixel(oled_cursor_x + column, oled_cursor_y + row,
                     (bits & (1U << row)) ? color :
                     (OLED_Color)!color);
    }
  }
  for (row = 0U; row < 8U; row++)
  {
    OLED_DrawPixel(oled_cursor_x + 5U, oled_cursor_y + row,
                   (OLED_Color)!color);
  }
  oled_cursor_x += 6U;
  return ch;
}

/* 将以空字符结尾的英文字符串写入显存。 */
void OLED_WriteString(const char *str, OLED_Color color)
{
  if (str == NULL)
  {
    return;
  }
  while ((*str != '\0') && (OLED_WriteChar(*str, color) != 0))
  {
    str++;
  }
}
